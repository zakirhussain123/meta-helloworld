## conf/layer.conf
```bitbake
# Layer configuration
BBPATH .= ":${LAYERDIR}"
BBFILES += "${LAYERDIR}/recipes-*/*/*.bb*"

# Layer priority
LAYERDEPENDS_meta-helloworld = ""
LAYERSERIES_COMPAT_meta-helloworld = "dunfell"
```
